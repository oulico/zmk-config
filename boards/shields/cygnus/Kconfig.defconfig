## boards/shields/cygnus/Kconfig.defconfig
```kconfig
if SHIELD_MY_KEYBOARD_LEFT

# Name must be less than 16 characters long!
config ZMK_KEYBOARD_NAME
    default "JH's Cygnus"

config ZMK_SPLIT_ROLE_CENTRAL
    default y

endif

if SHIELD_CYGNUS_LEFT || SHIELD_CYGNUS_RIGHT

config ZMK_SPLIT
    default y

endif
```

## boards/shields/cygnus/Kconfig.shield
```kconfig
# No whitespace after the comma or in your part name!
config SHIELD_CYGNUS_LEFT
    def_bool $(shields_list_contains,cygnus_left)

# No whitespace after the comma or in your part name!
config SHIELD_CYGNUS_RIGHT
    def_bool $(shields_list_contains,cygnus_right)
```
